/*
 * Copyright (c) 2025 The ZMK Contributors
 *
 * SPDX-License-Identifier: MIT
 */

#include <dt-bindings/zmk/behaviors.h>

/ {
    behaviors {
#if ZMK_BEHAVIOR_OMIT(AI)
        /omit-if-no-ref/
#endif
        ai: anti_idle {
            compatible = "zmk,behavior-anti-idle";
            #binding-cells = <1>;
            display-name = "Anti-idle";
        };
    };
};
