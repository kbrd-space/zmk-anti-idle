/*
 * Copyright (c) 2025 The ZMK Contributors
 *
 * SPDX-License-Identifier: MIT
 */

#include <dt-bindings/zmk/behaviors.h>

/ {
    behaviors {
#if ZMK_BEHAVIOR_OMIT(AI)
        /omit-if-no-ref/
#endif
        aim: aim {
            compatible = "zmk,behavior-anti-idle-mode";
            #binding-cells = <1>;
            display-name = "Anti-idle Mode";
        };
    };
};
