## Kconfig
```kconfig
menu "ZMK Anti-Idle Options"

config ZMK_ANTI_IDLE
    bool "Anti-Idle"
    default y

if ZMK_ANTI_IDLE

config ZMK_ANTI_IDLE_ENABLE_ONLY_CONNECTED
    bool "Enable only when connected"
    default y

config ZMK_ANTI_IDLE_SHARED_ENDPOINT_CONFIGURATION
    bool "The endpoint shares the same configuration for all the endpoint profiles"
    default n

endif

endmenu
```

## dts/bindings/behaviors/zmk,behavior-anti-idle-mode.yaml
```yaml
# Copyright (c) 2025 The ZMK Contributors
# SPDX-License-Identifier: MIT

description: Anti-idle Mode Action

compatible: "zmk,behavior-anti-idle-mode"

include: one_param.yaml
```

## dts/bindings/behaviors/zmk,behavior-anti-idle.yaml
```yaml
# Copyright (c) 2025 The ZMK Contributors
# SPDX-License-Identifier: MIT

description: Anti-idle Action

compatible: "zmk,behavior-anti-idle"

include: one_param.yaml
```

## dts/bindings/zmk,anti-idle-generic.yaml
```yaml
# Copyright (c) 2025 The ZMK Contributors
# SPDX-License-Identifier: MIT

description: "Anti-Idle Generic Configuration"

compatible: "zmk,anti-idle-generic"

properties:
  interval-ms:
    description: "Interval between sending anti-idle events in milliseconds."
    type: int
    default: 30000
  bindings:
    type: phandle-array
    required: true
  tap_ms:
    description: "Time in milliseconds to wait for a tap before sending the anti-idle event."
    type: int
  wait_ms:
    description: "Time in milliseconds to wait before sending the anti-idle event."
    type: int
```

## dts/bindings/zmk,anti-idle.yaml
```yaml
description: "Anti-Idle"

compatible: "zmk,anti-idle"

properties:
  interval-ms:
    description: "Interval between sending anti-idle events in milliseconds."
    type: int
    default: 30000
  bindings:
    type: phandle-array
    required: true
  tap_ms:
    description: "Time in milliseconds to wait for a tap before sending the anti-idle event."
    type: int
  wait_ms:
    description: "Time in milliseconds to wait before sending the anti-idle event."
    type: int
```
